## pkgs/Kconfig
```kconfig
# SPDX-License-Identifier: GPL-2.0
# The options of a PyrixOS build, RFC 0006 section 4. Every layer of the
# package set sees the resolved values as `config`.

mainmenu "PyrixOS"

choice
	prompt "Target architecture"
	default ARCH_X86_64

config ARCH_X86_64
	bool "x86_64"

config ARCH_RISCV64
	bool "RISC-V 64"

config ARCH_AARCH64
	bool "ARM64 (aarch64)"

endchoice

# The name the package set reads.
config ARCH
	string
	default "riscv64" if ARCH_RISCV64
	default "aarch64" if ARCH_AARCH64
	default "x86_64"

config RUST
	bool "Rust toolchain"
	default n
	help
	  Build LLVM, mrustc and Rust from source in the toolchains layer.
	  Nothing in a PyrixOS system needs them: its Python packages have
	  no Rust or C extensions. Turn this on to build Rust programs or
	  Python packages with Rust extensions on top of the package set.

menu "Binary cache"

config CACHE_URL
	string "Cache URL"
	default ""
	help
	  The binary cache the systems of this build fetch store paths
	  from, an https:// or file:/// URL (RFC 0005 section 9). With
	  CACHE_KEY set as well, every system gets an
	  /etc/lattice/settings.toml that names the cache, trusts its key
	  and requires signed provenance. Empty leaves systems without a
	  cache, so they build what they need.

config CACHE_KEY
	string "Cache public key"
	default ""
	help
	  The public key the cache signs with, as `lattice generate-key`
	  prints it: the key name, a colon and the key in base64.

endmenu
```
